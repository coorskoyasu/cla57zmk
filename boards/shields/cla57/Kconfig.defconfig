## boards/shields/cla57/Kconfig.defconfig
```kconfig
if SHIELD_CLA57_LEFT

    config ZMK_KEYBOARD_NAME
        default "CLA57(Left)"

    config ZMK_SPLIT_BLE_ROLE_CENTRAL
        default y

endif

if SHIELD_CLA57_LEFT || SHIELD_CLA57_RIGHT

    config ZMK_SPLIT
        default y

endif
```

## boards/shields/cla57/Kconfig.shield
```kconfig
config SHIELD_CLA57_LEFT
    def_bool $(shields_list_contains,cla57_left)

config SHIELD_CLA57_RIGHT
    def_bool $(shields_list_contains,cla57_right)
```
